## meta-bme/conf/layer.conf
```bitbake
# We have a conf and classes directory, add to BBPATH
BBPATH .= ":${LAYERDIR}"

# We have recipes-* directories, add to BBFILES
BBFILES += "${LAYERDIR}/recipes-*/*/*.bb \
            ${LAYERDIR}/recipes-*/*/*.bbappend"

BBFILE_COLLECTIONS += "meta-bme"
BBFILE_PATTERN_meta-bme = "^${LAYERDIR}/"
BBFILE_PRIORITY_meta-bme = "6"

LAYERDEPENDS_meta-bme = "core"
LAYERSERIES_COMPAT_meta-bme = "dunfell"
```

## meta-i2ctest/conf/layer.conf
```bitbake
# We have a conf and classes directory, add to BBPATH
BBPATH .= ":${LAYERDIR}"

# We have recipes-* directories, add to BBFILES
BBFILES += "${LAYERDIR}/recipes-*/*/*.bb \
            ${LAYERDIR}/recipes-*/*/*.bbappend"

BBFILE_COLLECTIONS += "meta-i2ctest"
BBFILE_PATTERN_meta-i2ctest ="^${LAYERDIR}/"
BBFILE_PRIORITY_meta-i2ctest = "6"

LAYERDEPENDS_meta-i2ctest = "core"
LAYERSERIES_COMPAT_meta-i2ctest = "dunfell"
```

## meta-python-modules/conf/layer.conf
```bitbake
# We have a conf and classes directory, add to BBPATH
BBPATH .= ":${LAYERDIR}"

# We have recipes-* directories, add to BBFILES
BBFILES += "${LAYERDIR}/recipes-*/*.bb \
            ${LAYERDIR}/recipes-*/*.bbappend"

BBFILE_COLLECTIONS += "meta-python-modules"
BBFILE_PATTERN_meta-python-modules = "^${LAYERDIR}/"
BBFILE_PRIORITY_meta-python-modules = "6"

LAYERDEPENDS_meta-python-modules = "core"
LAYERSERIES_COMPAT_meta-python-modules = "dunfell"
```
